
/*********************************************************************************************************************/
/*-----------------------------------------------------Includes------------------------------------------------------*/
#include "ring_buffer.h"
/*********************************************************************************************************************/

/*********************************************************************************************************************/
/*------------------------------------------------------Macros-------------------------------------------------------*/
/*********************************************************************************************************************/

/*********************************************************************************************************************/
/*-------------------------------------------------Global variables--------------------------------------------------*/
/*********************************************************************************************************************/

/*********************************************************************************************************************/
/*--------------------------------------------Private Variables/Constants--------------------------------------------*/
/*********************************************************************************************************************/

/*********************************************************************************************************************/
/*------------------------------------------------Function Prototypes------------------------------------------------*/
/*********************************************************************************************************************/

/*********************************************************************************************************************/
/*---------------------------------------------Function Implementations----------------------------------------------*/
// 링버퍼 초기화
void RingBufferInit(volatile RingBuffer* rb) {
    rb->head = 0;
    rb->tail = 0;
}

// 링버퍼 데이터 추가 (ISR 등에서 호출)
int RingBufferPut(volatile RingBuffer* rb, uint8 data) {
    uint16 next = (rb->head + 1) % RINGBUFFER_SIZE;
    if (next == rb->tail) {
        // 버퍼 오버플로우
        return -1;
    }
    rb->buffer[rb->head] = data;
    rb->head = next;
    return 0;
}

// 링버퍼에서 데이터 읽기 (파싱 함수에서 호출)
int RingBufferGet(volatile RingBuffer* rb, uint8* data) {
    if (rb->head == rb->tail) {
        // 버퍼 비어 있음
        return 0;
    }
    *data = rb->buffer[rb->tail];
    rb->tail = (rb->tail + 1) % RINGBUFFER_SIZE;
    return 1;
}

// 링버퍼 데이터 개수 확인
int RingBufferAvailable(volatile RingBuffer* rb) {
    if (rb->head >= rb->tail)
        return rb->head - rb->tail;
    else
        return RINGBUFFER_SIZE - rb->tail + rb->head;
}
/*********************************************************************************************************************/
